AUTOSAR XML (schema 4.0)
package /ActiveEcuC
  module config CanIf
    CanIfGeneral:
      CanIfBusOffNotification = true
      CanIfDataChecksumRxSupport = false
      CanIfDataChecksumTxSupport = false
      CanIfDevErrorDetect = true
      CanIfMetaDataSupport = false
      CanIfPrivateDataLengthCheck = true
      CanIfPublicCancelTransmitSupport = false
      CanIfPublicHandleTypeEnum = true
      CanIfPublicIcomSupport = false
      CanIfPublicMultipleDriverSupport = false
      CanIfPublicPnSupport = false
      CanIfPublicReadRxPduDataApi = true
      CanIfPublicReadRxPduNotifyStatusApi = false
      CanIfPublicReadTxPduNotifyStatusApi = false
      CanIfPublicSetDynamicTxIdApi = false
      CanIfPublicTxBuffering = true
      CanIfPublicTxConfirmPollingSupport = false
      CanIfPublicWakeupCheckValidByNM = false
      CanIfPublicWakeupCheckValidSupport = false
      CanIfTriggerTransmitSupport = false
      CanIfTxOfflineActiveSupport = false
      CanIfVersionInfoApi = true
    CanIfCtrlDrvCfg_CAN0 (CanIfCtrlDrvCfg)
      CanIfCtrlCfg_CAN0 (CanIfCtrlCfg): CanIfCtrlId=0, CanIfCtrlWakeupSupport=false, CanIfCtrlCanCtrlRef=CanController_0
    CanIfInitCfg: CanIfInitCfgSet=0, CanIfMaxBufferSize=64, CanIfMaxRxPduCfg=32, CanIfMaxTxPduCfg=32
      CanIfRxPduCfg_BCM_01 (CanIfRxPduCfg):
        CanIfRxPduCanId = 0x100
        CanIfRxPduCanIdType = STANDARD_CAN
        CanIfRxPduDlc = 8
        CanIfRxPduId = 0
        CanIfRxPduReadData = false
        CanIfRxPduReadNotifyStatus = false
        CanIfRxPduUserRxIndicationUL = CAN_TP
        CanIfRxPduCanIdRangeRef = CanIfBufferHthRef
        CanIfRxPduRef = BCM_01
      CanIfRxPduCfg_ECM_01 (CanIfRxPduCfg): CanIfRxPduCanId=0x200, CanIfRxPduCanIdType=STANDARD_CAN, CanIfRxPduDlc=8, CanIfRxPduId=1
      CanIfTxPduCfg_TCU_01 (CanIfTxPduCfg):
        CanIfTxPduCanId = 0x300
        CanIfTxPduCanIdType = STANDARD_CAN
        CanIfTxPduId = 0
        CanIfTxPduPnFilterPdu = false
        CanIfTxPduReadNotifyStatus = false
        CanIfTxPduTriggerTransmit = false
        CanIfTxPduType = STATIC
        CanIfTxPduUserTxConfirmationUL = CAN_TP
        CanIfTxPduBufferRef = CanIfBufferHthRef_0
        CanIfTxPduRef = TCU_01
