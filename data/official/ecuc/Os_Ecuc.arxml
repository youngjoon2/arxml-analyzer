AUTOSAR XML (schema 4-3-0)
package /ActiveEcuC
  module config Os: implementation-config-variant=VARIANT-POST-BUILD
    OsOS: OsStackMonitoring=true, OsStatus=EXTENDED, OsNumberOfCores=4, OsUseParameterAccess=false, OsUseResScheduler=true
      OsHooks: OsErrorHook=true, OsPostTaskHook=false, OsPreTaskHook=false, OsShutdownHook=true, OsStartupHook=true
      OsStackUsageMonitoring: OsStackUsageMonitoringPeriod=1000
    Task_10ms (OsTask): OsTaskActivation=1, OsTaskPriority=10, OsTaskSchedule=FULL, OsTaskStackSize=2048, OsTaskType=EXTENDED, OsTaskAccessingApplication=OsApplication_Core0
      OsTaskAutostart_Task_10ms (OsTaskAutostart): OsTaskAppModeRef=OSDEFAULTAPPMODE
    Task_100ms (OsTask): OsTaskActivation=1, OsTaskPriority=5, OsTaskSchedule=FULL, OsTaskStackSize=1024
    Alarm_10ms (OsAlarm): OsAlarmCounterRef=SystemCounter
      OsAlarmActivateTask: OsAlarmActivateTaskRef=Task_10ms
    SystemCounter (OsCounter): OsCounterMaxAllowedValue=65535, OsCounterMinCycle=1, OsCounterTicksPerBase=1, OsCounterType=HARDWARE, OsSecondsPerTick=0.001
    OsApplication_Core0 (OsApplication): OsApplicationCoreAssignment=0, OsTrusted=true, OsAppTaskRef=Task_10ms, OsAppTaskRef=Task_100ms
    OSDEFAULTAPPMODE (OsAppMode)
