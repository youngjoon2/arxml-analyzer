AUTOSAR XML (schema 4.0)
package /PortInterfaces/SenderReceiverInterfaces
  5 x sender receiver interface:
    SR_EngineSpeed: invalidation-policy{data-element=SpeedValue, handle-invalid=KEEP}
      data SpeedValue: type=Impl_uint16, init-value=0
    SR_EngineTemperature
      data TempValue: type=Impl_sint16, init-value=20
    SR_ThrottlePosition
      data ThrottleValue: type=Impl_uint8, init-value=0
    SR_CoolantTemperature
      data TempValue: type=Impl_sint16
    SR_VehicleSpeed
      data Speed: type=Impl_uint16
      data Quality: type=Impl_uint8
package /PortInterfaces/ClientServerInterfaces
  client server interface CS_EngineControl
    operation StartEngine: possible-error=[CS_EngineControl/E_NOT_OK, E_BUSY]
      arg StartMode: type=Impl_uint8, direction=IN
      arg Result: type=Impl_uint8, direction=OUT
    operation StopEngine
      arg StopMode: type=Impl_uint8, direction=IN
    operation GetEngineStatus
      arg Status: type=Impl_EngineState, direction=OUT
    error E_NOT_OK: error-code=1
    error E_BUSY: error-code=2
  client server interface CS_DiagnosticService: is-service=true
    operation ReadDTCInformation
      arg DTCStatusMask: type=Impl_uint8, direction=IN
      arg DTCList: type=Impl_DTCListType, direction=OUT
    operation ClearDTCInformation: possible-error=CS_DiagnosticService/E_NOT_OK
      arg DTC: type=Impl_uint32, direction=IN
    error E_NOT_OK: error-code=1
  client server interface CS_NvMService: is-service=true
    operation WriteBlock
      arg BlockId: type=Impl_uint16, direction=IN
      arg DataPtr: type=Impl_DataBufferType, direction=IN
    operation ReadBlock
      arg BlockId: type=Impl_uint16, direction=IN
      arg DataPtr: type=Impl_DataBufferType, direction=OUT
package /PortInterfaces/ModeSwitchInterfaces
  mode switch interface MSI_ECUMode
    mode-group:
      mode declaration group prototype CurrentMode: type=ECUMode
  mode switch interface MSI_VehicleMode
    mode-group:
      mode declaration group prototype VehicleMode: type=VehicleMode
package /PortInterfaces/NvDataInterfaces
  nv data interface NV_EngineData
    nv-datas:
      data EngineRunTime: type=Impl_uint32
      data TotalDistance: type=Impl_uint32
package /PortInterfaces/ParameterInterfaces
  parameter interface PI_EngineCalibration
    parameter data prototype IdleSpeed: type=Impl_uint16
    parameter data prototype MaxSpeed: type=Impl_uint16
    parameter data prototype WarmupTime: type=Impl_uint16
