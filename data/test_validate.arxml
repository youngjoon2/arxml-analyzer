AUTOSAR XML
package /TestPackage
  module config TestModule: definition=Test
    TestContainer
