AUTOSAR XML
package /TestPackage
  module config Module1
    Container1 ()
