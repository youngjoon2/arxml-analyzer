AUTOSAR XML
package /TestPackage
  module config Module1
    Container1 ()
    Container2 ()
  module config Module2
