AUTOSAR XML (schema 4.0)
package /Config
  module config TestModule
    TestContainer (): ecuc-numerical-param-value=100
